## config/boards/shields/dactyl_joakim/Kconfig.defconfig
```kconfig
if SHIELD_DACTYL_JOAKIM_LEFT

    config ZMK_KEYBOARD_NAME
        default "DACTYL-JOAKIM-L"

    config ZMK_SPLIT_BLE_ROLE_CENTRAL
        default y

endif

if SHIELD_DACTYL_JOAKIM_LEFT || SHIELD_DACTYL_JOAKIM_RIGHT

    config ZMK_SPLIT
        default y

endif
```

## config/boards/shields/dactyl_joakim/Kconfig.shield
```kconfig
config SHIELD_DACTYL_JOAKIM_LEFT
  def_bool $(shields_list_contains, dactyl_joakim_left)

config SHIELD_DACTYL_JOAKIM_RIGHT
  def_bool $(shields_list_contains, dactyl_joakim_right)
```
